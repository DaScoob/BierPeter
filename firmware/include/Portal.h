// SPDX-License-Identifier: AGPL-3.0-only
// Generated by firmware/embed-portal.py. Edit firmware/portal.html.
#pragma once
static const char PortalPage[] PROGMEM=R"BierPeterHTML(<!doctype html>
<html lang="de">
<meta charset="utf-8">
<meta name="viewport" content="width=device-width,initial-scale=1">
<title>BierPeter einrichten</title>
<style>
*{box-sizing:border-box}body{margin:0;background:#191a1c;color:#f3f4f5;font:16px system-ui}main{max-width:660px;margin:auto;padding:20px}section{padding:18px;background:#27292d;margin:14px 0;border:1px solid #44484e;border-radius:12px}h1{font-size:1.9rem}h2{font-size:1.2rem;margin:0 0 12px}p,small{line-height:1.5}small,.hint{color:#c6cbd2}label{display:block;margin:14px 0}input,select,button,a.button{font:inherit;width:100%;padding:12px;margin:6px 0;border:1px solid #747c86;border-radius:7px;background:#363b42;color:#fff}button{cursor:pointer}button.primary,a.button{background:#c9ee75;color:#192018;font-weight:650;border-color:#c9ee75}button:disabled{opacity:.5;cursor:wait}input[type=checkbox]{width:auto}button.minor{background:transparent}a{color:#d1f18d;overflow-wrap:anywhere}a.button{display:block;text-align:center;text-decoration:none}.status{white-space:pre-wrap;line-height:1.6}.error{color:#ffc29d}.good{color:#d1f18d}.steps{color:#c9ee75;font-size:.85rem}.key{overflow-wrap:anywhere;font-family:monospace}table{width:100%;border-collapse:collapse;table-layout:fixed;overflow-wrap:anywhere}td,th{text-align:left;padding:9px 4px;border-bottom:1px solid #454a51}.actions{display:flex;gap:10px;flex-wrap:wrap}.actions button{flex:1;min-width:140px}[hidden]{display:none!important}details{margin:16px 0}#feedback{padding:10px 0;min-height:2rem}#handoff{border-color:#c9ee75}input:focus,select:focus,button:focus{outline:2px solid #c9ee75;outline-offset:2px}
</style>
<main>
<small>* Mit KI erstellt · Firmware <span id="version">0.3.2-alpha</span></small>
<h1>BierPeter einrichten</h1>
<p id="identity" class="hint"></p>
<p class="steps">1 WLAN auswählen · 2 Speichern · 3 Verbindung testen · 4 Onlinebetrieb starten</p>
<section id="handoff" hidden>
<h2>Ins Heimnetz wechseln</h2>
<p>Der SoftAP wird nach der Bestätigung abgeschaltet. Anschließend das Smartphone mit dem Heimnetz verbinden. Bei einem lokalen Server reichen mobile Daten nicht aus.</p>
<p id="handoff-state" class="status" role="status"></p>
<a id="server-link" class="button" href="#">Serveroberfläche öffnen</a>
<button type="button" id="copy-server" class="minor">Serveradresse kopieren</button>
<label><input type="checkbox" id="auto-open"> Nach erkanntem Netzwechsel automatisch öffnen versuchen</label>
<button type="button" id="confirm-online" class="primary">Hinweis gelesen, Onlinebetrieb starten</button>
<button type="button" id="cancel-online" class="minor">Zurück zur Einrichtung</button>
</section>
<section id="configuration">
<h2>1 · WLAN und Server</h2>
<p class="hint">Die Liste zeigt vom BierPeter empfangene WLANs. Versteckte Netzwerke können manuell eingetragen werden. Unterstützt werden 2,4-GHz-Netzwerke.</p>
<label>Gefundene WLANs<select id="networks"><option value="">Netzwerk auswählen …</option></select></label>
<button type="button" id="scan" class="minor">WLAN-Liste aktualisieren</button>
<p id="scan-state" class="hint" role="status"></p>
<form id="config">
<label>WLAN-Name (SSID)<input name="ssid" id="ssid" maxlength="32" autocomplete="off" required></label>
<label>WLAN-Passwort<input name="password" id="password" type="password" maxlength="64" autocomplete="new-password"></label>
<p id="password-state" class="hint"></p>
<label><input name="clear_password" id="clear-password" type="checkbox"> Offenes WLAN ohne Passwort verwenden</label>
<label>Serveradresse<input name="server" id="server" type="url" maxlength="180" placeholder="http://SERVER-IP:6017" autocomplete="off" required></label>
<p class="hint">Erreichbare LAN-Adresse des BierPeter-Servers mit Port 6017. Kein localhost. Eine bereits eingerichtete Adresse wird übernommen.</p>
<label>Server-Zugriffsschlüssel<input name="key" id="server-key" type="password" maxlength="128" autocomplete="new-password"></label>
<p id="key-state" class="hint"></p>
<details><summary>Welcher Schlüssel ist gemeint?</summary><p>Gemeint ist <code>DEVICE_API_KEY</code> aus der Datei <code>~/BierPeter/.env</code> auf dem Server. Derselbe Zugriffsschlüssel verbindet die Geräte mit diesem Server. Der BierPeter-Name, die Gerätekennung, der öffentliche Geräteschlüssel und der Wiederherstellungsschlüssel des Kontos gehören nicht in dieses Feld.</p></details>
<button class="primary" id="save">2 · Einstellungen speichern</button>
</form>
</section>
<section id="connection">
<h2>3 · Verbindung prüfen</h2>
<div id="connection-state" class="status" role="status" aria-live="polite">Gerätestatus wird geladen …</div>
<p class="hint">Die Prüfung verbindet den BierPeter mit dem WLAN, prüft den Server und meldet das Gerät mit dem Server-Zugriffsschlüssel an. Der SoftAP kann beim Funkkanalwechsel kurz unterbrochen werden. Die Seite versucht automatisch, die Statusverbindung wiederherzustellen.</p>
<button type="button" id="test" class="primary" hidden>Verbindung testen</button>
<button type="button" id="online" class="primary" hidden>4 · Onlinebetrieb starten</button>
</section>
<p id="feedback" class="status" role="status" aria-live="polite"></p>
<details id="local-session"><summary>Lokale Session und Geräteschlüssel</summary>
<section><h2>Spielstand</h2><div id="game"></div><table><thead><tr><th>Gerät</th><th>Zustand</th></tr></thead><tbody id="devices"></tbody></table><div id="results"></div></section>
<section><h2>Lokale Aufstellung</h2><form id="session"><label>Spielmodus<select name="mode"><option value="relay">Staffellauf</option><option value="duel">1vs1</option></select></label><label>Geräteauswahl<select name="selection"><option value="auto">Automatisch</option><option value="manual">Manuell</option></select></label><div id="choices"></div><label><input name="locked" type="checkbox"> Aufnahme weiterer Geräte sperren</label><button id="save-session">Aufstellung übernehmen</button></form><p class="hint">Nur vor einem Run änderbar. Die Aufstellung wird nicht dauerhaft gespeichert.</p></section>
<section><h2>Öffentlicher Geräteschlüssel</h2><p id="public" class="key"></p><p class="hint">Automatisch erzeugter Schlüssel zum unabhängigen Vergleichen. Nicht mit dem Server-Zugriffsschlüssel verwechseln.</p></section>
</details>
<small>Manueller Portalzugang: http://192.168.4.1/</small>
</main>
<script>
'use strict';
const $=id=>document.getElementById(id);
let current=null,dirty=false,sessionDirty=false,working=false,polling=false,pending=null,initialized=false,scanStarted=false,handoff=false,switching=false,switchAfter=0;
const stageText={idle:'Einstellungen gespeichert. Verbindung kann geprüft werden.',wifi:'1/3 · WLAN-Verbindung wird aufgebaut …',health:'2/3 · Server-Erreichbarkeit wird geprüft …',auth:'3/3 · Server-Zugriffsschlüssel und Geräteanmeldung werden geprüft …',passed:'Verbindungstest erfolgreich. Serverkommunikation pausiert bis zum Onlinebetrieb.',failed:'Verbindungstest fehlgeschlagen.',switching:'Onlinebetrieb startet. SoftAP wird abgeschaltet.',online:'Onlinebetrieb ist eingestellt.'};
function say(text,error=false){$('feedback').textContent=text;$('feedback').className='status'+(error?' error':'');}
async function request(path,data){const controller=new AbortController(),timer=setTimeout(()=>controller.abort(),5000);try{const options={signal:controller.signal,cache:'no-store'};if(data!==undefined)Object.assign(options,{method:'POST',headers:{'Content-Type':'application/json','X-BierPeter-Local':'1'},body:JSON.stringify(data)});const r=await fetch(path,options);const value=await r.json();if(!r.ok)throw Error(value.error||'Anfrage fehlgeschlagen ('+r.status+')');return value;}finally{clearTimeout(timer);}}
function buttons(){const blocked=working||!!pending||!!current?.busy||!!current?.scanning||!!current?.run_open||switching;for(const control of document.querySelectorAll('#config input,#save,#networks,#scan,#test,#online,#save-session'))control.disabled=blocked;$('test').hidden=!current?.saved||!!current?.tested||handoff;$('test').disabled=blocked||dirty;$('online').hidden=!current?.tested||handoff||dirty;$('online').disabled=blocked||dirty;$('scan').disabled=blocked;}
function fill(s){if(dirty||pending)return;$('ssid').value=s.ssid||'';$('server').value=s.server||'';$('password').value='';$('server-key').value='';$('clear-password').checked=false;}
function showNetworks(s){const select=$('networks'),selected=select.value;select.replaceChildren();const initial=document.createElement('option');initial.value='';initial.textContent='Netzwerk auswählen …';select.append(initial);for(const net of s.networks||[]){const option=document.createElement('option');option.value=net.ssid;option.textContent=net.ssid+' · '+net.rssi+' dBm · '+(net.open?'offen':'geschützt');select.append(option);}select.value=selected;$('scan-state').textContent=s.scanning?'WLAN-Suche läuft …':s.scan_error||((s.networks||[]).length+' WLAN(s) gefunden'+(s.scan_age_s?' · vor '+s.scan_age_s+' s':''));}
function applySetup(s){current=s;$('version').textContent=s.firmware||'0.3.2-alpha';$('identity').textContent='Gerätekennung: '+(s.id||'');
 if(!initialized){fill(s);initialized=true;}else if(!dirty&&!pending)fill(s);
 if(pending&&s.action_id===pending.id&&s.action_state!=='idle'){
   const job=pending;pending=null;working=false;
   if(s.action_state==='done'){if(job.kind==='save'){dirty=false;fill(s);say('Einstellungen dauerhaft gespeichert. Verbindung jetzt testen.');}else if(job.kind==='test')say('Verbindungstest gestartet.');else if(job.kind==='online'){switching=true;switchAfter=Date.now()+6500;$('confirm-online').hidden=true;$('cancel-online').hidden=true;$('handoff-state').textContent='SoftAP wird in sechs Sekunden abgeschaltet. Danach ins Heimnetz wechseln.';}else if(job.kind==='session'){sessionDirty=false;say('Aufstellung übernommen.');}}
   else say(s.action_error||'Die Anfrage konnte nicht übernommen werden.',true);
 }else if(pending&&Number(s.action_id)>Number(pending.id)){pending=null;working=false;say('Eine weitere Anfrage wurde inzwischen bearbeitet. Aktuellen Zustand prüfen.',true);}
 showNetworks(s);$('password-state').textContent=s.password_saved?'WLAN-Passwort gespeichert. Leer lassen, um es für dieses WLAN zu behalten.':'Noch kein WLAN-Passwort gespeichert.';$('key-state').textContent=s.key_saved?'Server-Zugriffsschlüssel gespeichert. Leer lassen, um ihn zu behalten.':'Noch kein Server-Zugriffsschlüssel gespeichert.';
 const actual='WLAN: '+(s.wifi_connected?'Verbunden':'Nicht verbunden')+'\nServer: '+(s.server_online?'Online':s.stage==='passed'?'Geprüft, Kommunikation pausiert':'Offline / noch nicht bestätigt');
 $('connection-state').textContent=(s.saved?(stageText[s.stage]||s.stage):'Zuerst WLAN und Server konfigurieren.')+'\n'+actual+(s.server_version?'\nServerversion: '+s.server_version:'')+(s.error?'\n'+s.error:'');$('connection-state').className='status'+(s.error?' error':s.tested?' good':'');buttons();
}
async function action(path,data,kind){if(working||pending)return;working=true;buttons();try{const response=await request(path,data);pending={id:response.request,kind,since:Date.now()};say(kind==='save'?'Einstellungen werden gespeichert …':'Anfrage wird bearbeitet …');}catch(e){working=false;say(e.message,true);buttons();}}
$('config').addEventListener('input',()=>{dirty=true;say('Änderungen noch nicht gespeichert. Danach Verbindung erneut testen.');buttons();});
$('networks').addEventListener('change',()=>{if(!$('networks').value)return;$('ssid').value=$('networks').value;dirty=true;buttons();});
$('config').onsubmit=e=>{e.preventDefault();const f=e.target;action('/config',{ssid:f.elements.namedItem('ssid').value,password:f.elements.namedItem('password').value,server:f.elements.namedItem('server').value,key:f.elements.namedItem('key').value,clear_password:$('clear-password').checked},'save');};
$('test').onclick=()=>action('/test',{},'test');$('scan').onclick=()=>{scanStarted=true;action('/scan',{},'scan');};
function showHandoff(){if(!current?.tested||dirty)return;handoff=true;$('handoff').hidden=false;$('configuration').hidden=true;$('connection').hidden=true;$('local-session').hidden=true;$('server-link').href=current.server;$('server-link').textContent='Server öffnen: '+current.server;$('confirm-online').hidden=false;$('handoff-state').textContent='Erst nach der Bestätigung wird das Geräte-WLAN abgeschaltet.';buttons();$('handoff').scrollIntoView?.();}
$('online').onclick=showHandoff;$('cancel-online').onclick=()=>{handoff=false;$('handoff').hidden=true;$('configuration').hidden=false;$('connection').hidden=false;$('local-session').hidden=false;buttons();};
$('confirm-online').onclick=()=>action('/online',{},'online');
$('copy-server').onclick=async()=>{try{await navigator.clipboard.writeText(current.server);say('Serveradresse kopiert.');}catch{const input=document.createElement('input');input.value=current.server;$('handoff').append(input);input.select();say('Serveradresse markieren und manuell kopieren.');}};
function tryOpen(){if(switching&&Date.now()>=switchAfter&&$('auto-open').checked&&navigator.onLine)location.assign(current.server);}
window.addEventListener('online',tryOpen);document.addEventListener('visibilitychange',()=>{if(!document.hidden)tryOpen();});
$('session').addEventListener('input',()=>sessionDirty=true);$('session').onsubmit=e=>{e.preventDefault();const f=e.target;action('/session',{mode:f.elements.namedItem('mode').value,selection:f.elements.namedItem('selection').value,locked:f.elements.namedItem('locked').checked,devices:[...document.querySelectorAll('[data-peer]:checked')].map(x=>x.dataset.peer)},'session');};
function line(parent,text){const p=document.createElement('p');p.textContent=text;parent.append(p);}
async function game(){if(!$('local-session').open||current?.busy||pending||switching)return;const s=await request('/status');$('public').textContent=s.public;$('game').textContent=s.state+(s.demo?' · DEMO':'')+' · '+(s.ready?'bereit':'Sensorbereitschaft ausstehend');$('devices').replaceChildren();for(const d of s.devices||[]){const tr=document.createElement('tr');for(const text of [d.id,(d.connected?'Verbunden':'Erkannt')+' · '+(d.ready?'bereit':'wartet')]){const td=document.createElement('td');td.textContent=text;tr.append(td);}$('devices').append(tr);}$('results').replaceChildren();for(const l of s.lanes||[])line($('results'),(l.side?'Rechts':'Links')+': Glas '+(l.present?'vorhanden':'angehoben')+(l.done?' · '+(l.duration_us/1e6).toFixed(3)+' s':l.elapsed_us?' · läuft '+(l.elapsed_us/1e6).toFixed(1)+' s':''));if(s.result){for(let side=0;side<2;++side)line($('results'),'Team '+(side?'B':'A')+': '+(s.result.total_us[side]/1e6).toFixed(3)+' s');for(const x of s.result.splits)line($('results'),x.device+' / '+(x.side?'rechts':'links')+': '+(x.duration_us/1e6).toFixed(3)+' s');}if(!sessionDirty){$('choices').replaceChildren();for(const d of s.devices||[]){const label=document.createElement('label'),input=document.createElement('input');input.type='checkbox';input.dataset.peer=d.id;input.checked=d.selected;label.append(input,document.createTextNode(' '+d.id));for(const dir of [-1,1]){const b=document.createElement('button');b.type='button';b.textContent=dir<0?'↑ Nach vorne':'↓ Nach hinten';b.onclick=()=>{sessionDirty=true;const t=dir<0?label.previousElementSibling:label.nextElementSibling;if(t){if(dir<0)label.parentNode.insertBefore(label,t);else label.parentNode.insertBefore(t,label);}};label.append(b);}$('choices').append(label);}}}
async function poll(){if(polling||document.hidden)return;if(switching){$('handoff-state').textContent=Date.now()>=switchAfter?'Geräte-WLAN wird beendet. Jetzt ins Heimnetz wechseln und die Serveroberfläche öffnen.':'Onlinebetrieb startet. Gleich ins Heimnetz wechseln.';return;}polling=true;try{const s=await request('/setup');applySetup(s);if(!scanStarted&&!s.scanning&&!s.online_enabled&&!s.run_open&&!s.busy){scanStarted=true;await action('/scan',{},'scan');}await game();}catch(e){if(current?.busy||pending?.kind==='test')say('Verbindung zum Geräteportal kurz unterbrochen. Bei Bedarf erneut mit dem BierPeter-WLAN verbinden. Der Statusabruf wird wiederholt.');else say('Geräteportal momentan nicht erreichbar. Verbindung zum BierPeter-WLAN prüfen.',true);}finally{polling=false;if(pending&&Date.now()-pending.since>30000){pending=null;working=false;say('Keine Bestätigung erhalten. Status erneut prüfen; nicht automatisch erneut speichern.',true);buttons();}}}
poll();setInterval(poll,1000);
</script>
</html>
)BierPeterHTML";
